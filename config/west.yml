## config/west.yml
```yaml
manifest:
  remotes:
    - name: zmkfirmware
      url-base: https://github.com/bbelmar
  projects:
    - name: zmk
      remote: zmkfirmware
      revision: ZMK-UPDATE-2025
      import: app/west.yml
  self:
    path: config
```
